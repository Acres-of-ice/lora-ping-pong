## components/sx126x/Kconfig.projbuild
```kconfig
menu "SX1262 Radio"

	config SX126X_GPIO_RANGE_MAX
		int
		default 33 if IDF_TARGET_ESP32
		default 46 if IDF_TARGET_ESP32S2
		default 48 if IDF_TARGET_ESP32S3
		default 21 if IDF_TARGET_ESP32C3
		default 30 if IDF_TARGET_ESP32C6
		default 48

	comment "Defaults match the Repeater PCB: Ai-Thinker Ra-01SH on an ESP32-C3-MINI-1U"

	config SX126X_MOSI_GPIO
		int "MOSI GPIO"
		range 0 SX126X_GPIO_RANGE_MAX
		default 7
		help
			Repeater PCB: IO7 (FSPID/MOSI) -> Ra-01SH pin 14.

	config SX126X_MISO_GPIO
		int "MISO GPIO"
		range 0 SX126X_GPIO_RANGE_MAX
		default 2
		help
			Repeater PCB: IO2 (FSPIQ/MISO) <- Ra-01SH pin 13. IO2 is a boot
			strapping pin that must read high at reset; R4 (10k to 3V3) holds it
			there while the radio's MISO is high-impedance.

	config SX126X_SCK_GPIO
		int "SCK GPIO"
		range 0 SX126X_GPIO_RANGE_MAX
		default 6
		help
			Repeater PCB: IO6 (FSPICLK) -> Ra-01SH pin 12.

	config SX126X_NSS_GPIO
		int "NSS (chip select) GPIO"
		range 0 SX126X_GPIO_RANGE_MAX
		default 10
		help
			Repeater PCB: IO10 (FSPICS0) -> Ra-01SH pin 15.

	config SX126X_RST_GPIO
		int "RST GPIO"
		range 0 SX126X_GPIO_RANGE_MAX
		default 21
		help
			Repeater PCB: IO21 (U0TXD) -> JP6 -> Ra-01SH pin 4. This is UART0's TX
			pin, so the console must not be on UART0 (sdkconfig.defaults moves it
			to USB-Serial-JTAG). The ROM bootloader still prints on it before the
			app starts, which just pulses the radio's reset - harmless, since
			init hard-resets the radio anyway.

	config SX126X_BUSY_GPIO
		int "BUSY GPIO"
		range 0 SX126X_GPIO_RANGE_MAX
		default 1
		help
			Repeater PCB: IO1 <- Ra-01SH pin 10. The SX126x holds this high while
			it is processing a command; the driver waits on it before every SPI
			transaction. If it never drops, the module is miswired or unpowered.

	config SX126X_DIO1_GPIO
		int "DIO1 (interrupt) GPIO"
		range 0 SX126X_GPIO_RANGE_MAX
		default 20
		help
			Repeater PCB: IO20 (U0RXD) <- JP5 <- Ra-01SH pin 6. Carries
			TxDone/RxDone/CrcErr/Timeout. UART0's RX pin, so as with RST the
			console must live on USB-Serial-JTAG.

	choice SX126X_SPI_HOST
		prompt "SPI peripheral"
		default SX126X_SPI2_HOST
		config SX126X_SPI2_HOST
			bool "SPI2_HOST"
		config SX126X_SPI3_HOST
			depends on IDF_TARGET_ESP32 || IDF_TARGET_ESP32S2 || IDF_TARGET_ESP32S3
			bool "SPI3_HOST"
	endchoice

endmenu
```

## main/Kconfig.projbuild
```kconfig
menu "LoRa Test Rig"

	choice ROLE
		prompt "Device role"
		default ROLE_SENDER
		help
			Both roles ship in one firmware; flash the same build twice with this
			set differently. Keeping them in one project stops the packet format
			and radio tables drifting apart.
		config ROLE_SENDER
			bool "Sender"
			help
				Transmits numbered packets and waits for acknowledgements. Owns
				the battery sense ADC and the max-drain WiFi load.
		config ROLE_RECEIVER
			bool "Receiver"
			help
				Listens, acknowledges, reports link quality, and logs the battery
				telemetry it receives to a CSV on SPIFFS.
	endchoice

	menu "Radio defaults"
		comment "Starting values only - the dashboard overrides these and saves to NVS"

		config LINK_FREQ_HZ
			int "Carrier frequency (Hz)"
			range 150000000 960000000
			default 865062500
			help
				865.0625 MHz is the first IN865 channel, the bottom of the 865-867 MHz
				Indian ISM band. It is deliberately not 865.000 MHz: a carrier there
				puts half of a 125 kHz signal below the band edge. Keep the carrier
				at least half the bandwidth inside the band (BW 250 kHz needs
				865.125 MHz or above).

				Anything the SX1262 tunes (150-960 MHz) is accepted, here and from the
				dashboard. The Ra-01SH's matching network and antenna are built for
				803-930 MHz, though: outside that the radio works, but range drops
				sharply.

		config LINK_DEFAULT_SF
			int "Spreading factor"
			range 5 12
			default 7

		config LINK_DEFAULT_CR
			int "Coding rate denominator (4/x)"
			range 5 8
			default 5

		config LINK_DEFAULT_PREAMBLE
			int "Preamble length (symbols)"
			range 1 65535
			default 8
			help
				The SX1262 takes 1-65535. Short preambles give the receiver little to
				lock onto, so packets get missed more easily; 8 is the usual default.

		config LINK_DEFAULT_TX_DBM
			int "Transmit power (dBm)"
			range -9 22
			default 22
			help
				+22 dBm is the SX1262 maximum. Check this is legal for your band
				and antenna gain before running it outdoors.
	endmenu

	menu "Sender"
		config SENDER_DEFAULT_INTERVAL_MS
			int "Interval between packets (ms)"
			range 0 600000
			default 5000
			help
				Measured from the start of one exchange to the next. At high
				spreading factors a single exchange can exceed this, in which case
				the sender simply runs back-to-back.

				0 means back-to-back deliberately: transmit again the moment the
				acknowledgement arrives. That is the setting for a maximum-drain
				battery test, since it keeps the PA keyed for most of the wall
				clock. Check your local duty-cycle rules before running it on air.

		config SENDER_DEFAULT_PAYLOAD
			int "Payload size (bytes)"
			range 17 255
			default 255
			help
				255 is the LoRa maximum and the honest worst case for a range test.
				Be aware what it costs: at SF12/BW125 one packet is ~9.0 s in the
				air. The 14-byte acknowledgement adds ~1.2 s, so a full exchange is
				~10.2 s. The dashboard shows both live so you can trade it off.

				17 is the floor: the battery packet must fit.
	endmenu

	menu "Network"
		choice NET_MODE
			prompt "WiFi mode"
			default NET_MODE_AP
			help
				Access point is the field default: there is no router in a
				car park, and you need the dashboard on a phone while walking.
			config NET_MODE_AP
				bool "Access point"
			config NET_MODE_STA
				bool "Join an existing network"
		endchoice

		config NET_AP_SSID_PREFIX
			string "AP SSID prefix"
			default "lora"
			help
				The role is appended: "-send" on the sender, "-recv" on the
				receiver. The two boards are told apart on air, and flipping a
				board's role renames its access point with it.

		config NET_AP_PASSWORD
			string "AP password"
			default ""
			help
				Empty (the default) runs an open network: anyone in range can join
				and use the dashboard, including reboot and config push. For WPA2
				set 8-63 characters. A shorter password cannot start the access
				point at all, so the build refuses it rather than leave the board
				in a reboot loop.

		config NET_AP_CHANNEL
			int "AP channel"
			range 1 13
			default 1

		config NET_STA_SSID
			string "WiFi SSID"
			default "myssid"

		config NET_STA_PASSWORD
			string "WiFi password"
			default "mypassword"
	endmenu

	menu "Max-drain load (sender)"
		config POWERLOAD_ARM_DELAY_S
			int "Boot delay before the load starts (seconds)"
			range 0 120
			default 15
			help
				The load's on/off state is saved, so once switched on, a load heavy
				enough to brown the board out would otherwise persist itself into a
				reset loop with no window to switch it off. This delay guarantees the
				dashboard is always reachable for at least this long after boot.

				Do not set this to 0 unless you are certain the supply can carry the
				load, and you have a way to erase NVS if it cannot.

		config POWERLOAD_GAP_PERIOD_MS
			int "Transmit burst length before a breathing gap (ms)"
			range 100 10000
			default 500

		config POWERLOAD_JOIN_GRACE_MS
			int "Pause on a new station joining (ms)"
			range 0 15000
			default 4000
			help
				The periodic breathing gap is not synchronised to the moment a client
				actually needs quiet air, which is right after association while it
				negotiates DHCP. Starved there, a phone's own connectivity check gives
				up fast: association followed by a client-initiated leave (reason 3)
				within a couple hundred ms, rather than the AP-side four-way-handshake
				timeout (reason 15) the breathing gap already covers.

				This suspends the flood for this long whenever WIFI_EVENT_AP_STACONNECTED
				fires, giving DHCP and a captive-portal check a clear run. 0 disables it.

		config POWERLOAD_GAP_MS
			int "Breathing gap length (ms)"
			range 0 500
			default 50
			help
				The broadcast flood saturates the WiFi transmit path, which starves
				the WPA2 four-way handshake: a client associates and is then deauthed
				with reason 15 (4WAY_HANDSHAKE_TIMEOUT) a few seconds later. Since the
				load's state is persisted, that locks you out of the very dashboard you
				would use to turn it off.

				This pauses the flood briefly and periodically so association and TCP
				get a clear window. The default 50 ms every 500 ms costs about 10% of
				the WiFi share of the load - a few mA - and makes the AP joinable.

				0 disables the gaps entirely. Only do that if you do not need the
				dashboard while the load runs, and remember the boot delay is then
				your only window in.

		config POWERLOAD_CPU_SPIN
			bool "Also busy-loop the CPU while the load is on"
			default y
			help
				FreeRTOS's idle task halts the core with `waiti`, which saves power -
				the opposite of what a worst-case draw test wants. This adds a
				low-priority spin task to keep the CPU out of that state.

				Worth roughly 10-15 mA on top of the radio load. Turn it off first if
				the supply cannot quite carry everything, since it buys the least
				current for the most risk.
	endmenu

	menu "Battery (sender)"
		config BATTERY_ADC_CHANNEL
			int "Battery-sense ADC1 channel"
			range 0 4
			default 0
			help
				Must be an ADC1 channel: ADC2 is unusable while WiFi is active.
				On the Repeater PCB the BAT+ divider (R12 100k over R13 30k, C11
				100nF) feeds IO0, which is ADC1 channel 0.

		config BATTERY_DIVIDER_X1000
			int "Battery divider ratio x1000 (until calibrated)"
			range 1000 20000
			default 4333
			help
				Battery millivolts per sense-pin millivolt, times 1000. The Repeater
				PCB's 100k/30k divider is nominally (100k + 30k) / 30k = 4.333.

				Resistor tolerance and ADC gain error move the real figure a long way
				from that - one board read 873 mV at the pin with 4.16 V on the cell,
				a ratio of 4.77. Calibrate it from the sender dashboard against a
				multimeter; the result is saved to NVS and replaces this value.
	endmenu

endmenu
```
